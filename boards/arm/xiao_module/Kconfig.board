## boards/arm/xiao_module/Kconfig.board
```kconfig
# XIAO BLE board configuration

# Copyright (c) 2022 Marcin Niestroj
# SPDX-License-Identifier: Apache-2.0

config BOARD_XIAO_MODULE
	bool "XIAO Module"
	depends on SOC_NRF52840_QIAA
```
